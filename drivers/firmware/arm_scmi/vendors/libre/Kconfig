## drivers/firmware/arm_scmi/vendors/libre/Kconfig
```kconfig
# SPDX-License-Identifier: GPL-2.0-only
menu "ARM SCMI Libre Computer Vendor Protocols"

config LIBRE_SCMI_TYPEC
	tristate "Libre Computer SCMI Type-C (UCSI) protocol"
	depends on ARM_SCMI_PROTOCOL || (COMPILE_TEST && OF)
	help
	  This enables the Libre Computer SCMI vendor protocol 0x80
	  ("lc-typec"), which carries a UCSI register file between Linux
	  and an SCMI server that owns a USB Type-C power port, such as
	  the RK3399 Cortex-M0 firmware on ROC-RK3399-PC. The UCSI client
	  is UCSI_SCMI.

	  To compile this driver as a module, choose M here: the
	  module will be called lc-typec.

endmenu
```
