// SPDX-License-Identifier: GPL-2.0
/*
 * Copyright (c) 2019 BayLibre SAS. All rights reserved.
 * Author: Jerome Brunet <jbrunet@baylibre.com>
 */

/dts-v1/;

#include "meson-gxl-s905d.dtsi"
#include "meson-gx-libretech-pc.dtsi"

/ {
	compatible = "libretech,aml-s905d-pc", "amlogic,s905d",
		     "amlogic,meson-gxl";
	model = "Libre Computer AML-S905D-PC";
};

/ {
	reserved-memory {
		linux,cma {
			/*
			 * AML-S905D-PC comes in up to 2 GiB RAM variants. Set CMA
			 * to 448 MiB (max formula for 2 GiB). U-boot caps to
			 * min(DT, calculated) based on detected RAM.
			 */
			size = <0x0 0x1C000000>;
		};
	};
};
